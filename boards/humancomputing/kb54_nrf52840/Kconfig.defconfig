## boards/humancomputing/kb54_nrf52840/Kconfig.defconfig
```kconfig
if BOARD_KB54_NRF52840_L

config ZMK_SPLIT_ROLE_CENTRAL
    default y

# USB HID output; ZMK only allows this on the central half.
config ZMK_USB
    default y

endif # BOARD_KB54_NRF52840_L



if BOARD_KB54_NRF52840_L || BOARD_KB54_NRF52840_R

config ZMK_SPLIT
    default y

config BT_CTLR
    default BT

config PINCTRL
    default y

config ZMK_BLE
    default y

# BLE TX Power
choice BT_CTLR_TX_PWR
    default BT_CTLR_TX_PWR_PLUS_8
endchoice

# Enable MPU
config ARM_MPU
    default y

# Enable GPIO
config GPIO
    default y

# Flash configuration
config SETTINGS
    default y

config MPU_ALLOW_FLASH_WRITE
    default y

config NVS
    default y

choice SETTINGS_BACKEND
    default SETTINGS_NVS
endchoice

config FLASH
    default y

config FLASH_PAGE_LAYOUT
    default y

config FLASH_MAP
    default y

# Enable 32kHz crystal
choice CLOCK_CONTROL_NRF_SOURCE
    default CLOCK_CONTROL_NRF_K32SRC_XTAL
endchoice

# Deep sleep support
config ZMK_SLEEP
    default y

# Battery
config ZMK_BATTERY_REPORTING
    default y

choice ZMK_BATTERY_REPORTING_FETCH_MODE
    default ZMK_BATTERY_REPORTING_FETCH_MODE_STATE_OF_CHARGE
endchoice

# Display
config ZMK_DISPLAY
    default y

config ZMK_DISPLAY_BLANK_ON_IDLE
    default n

# Sharp LCD VCOM toggle thread priority (same as nice!view)
config LS0XX_VCOM_THREAD_PRIO
    default 11

# LVGL draw buffer size as % of the screen
config LV_Z_VDB_SIZE
    default 100

# Screen pixel density used by LVGL for scaling
config LV_DPI_DEF
    default 161

# 1-bit monochrome Sharp memory LCD
config LV_Z_BITS_PER_PIXEL
    default 1

choice LV_COLOR_DEPTH
    default LV_COLOR_DEPTH_1
endchoice

choice ZMK_DISPLAY_WORK_QUEUE
    default ZMK_DISPLAY_WORK_QUEUE_DEDICATED
endchoice

choice ZMK_DISPLAY_STATUS_SCREEN
    default ZMK_DISPLAY_STATUS_SCREEN_CUSTOM
endchoice

config LV_Z_MEM_POOL_SIZE
    default 8192 if ZMK_DISPLAY_STATUS_SCREEN_CUSTOM

config ZMK_DISPLAY_STATUS_SCREEN_CUSTOM
    imply KB54_WIDGET_STATUS

config KB54_WIDGET_STATUS
    bool "Custom KB54 status widget"
    select LV_USE_IMAGE
    select LV_USE_CANVAS
    select LV_FONT_MONTSERRAT_22
    select LV_FONT_MONTSERRAT_18
    select LV_FONT_MONTSERRAT_16
    select LV_FONT_MONTSERRAT_14
    select LV_FONT_MONTSERRAT_12
    select LV_FONT_UNSCII_8
    select LV_FONT_UNSCII_16

# Adafruit nRF52 UF2 bootloader magic-value mapping for the &bootloader
# behavior (boot retention set up via nrf52840_uf2_boot_mode.dtsi).
choice ZMK_BOOTMODE_MAGIC_VALUE_BOOTLOADER_TYPE
    default ZMK_BOOTMODE_MAGIC_VALUE_BOOTLOADER_TYPE_ADAFRUIT_NRF52
endchoice

# Code output
config USE_DT_CODE_PARTITION
    default y

config BUILD_OUTPUT_UF2
    default y

if USB

config USB_NRFX
    default y

config USB_DEVICE_STACK
    default y

endif # USB

endif # BOARD_KB54_NRF52840_L || BOARD_KB54_NRF52840_R
```

## config/boards/arm/kb54_nrf52840/Kconfig.defconfig
```kconfig
if BOARD_KB54_NRF52840_L

config BOARD
    default "kb54_nrf52840_l"

config ZMK_SPLIT_ROLE_CENTRAL
    default y

endif # BOARD_KB54_NRF52840_L



if BOARD_KB54_NRF52840_R

config BOARD
    default "kb54_nrf52840_r"

endif # BOARD_KB54_NRF52840_R



if BOARD_KB54_NRF52840_L || BOARD_KB54_NRF52840_R

config ZMK_SPLIT
    default y

config BT_CTLR
    default BT

config PINCTRL
    default y

# Enable both USB and BLE
config ZMK_USB
    default y

config ZMK_BLE
    default y

# BLE TX Power
choice BT_CTLR_TX_PWR
    default BT_CTLR_TX_PWR_PLUS_8
endchoice

# Enable MPU
config ARM_MPU
    default y

# Enable GPIO
config GPIO
    default y

# Flash configuration
config SETTINGS
    default y

config MPU_ALLOW_FLASH_WRITE
    default y

config NVS
    default y

config SETTINGS_NVS
    default y

config FLASH
    default y

config FLASH_PAGE_LAYOUT
    default y

config FLASH_MAP
    default y

# Enable 32kHz crystal
choice CLOCK_CONTROL_NRF_SOURCE
    default CLOCK_CONTROL_NRF_K32SRC_XTAL
endchoice

# Battery
config ZMK_BATTERY_REPORTING
    default y

config ZMK_BATTERY_REPORT_INTERVAL
    default 15

choice ZMK_BATTERY_REPORTING_FETCH_MODE
    default ZMK_BATTERY_REPORTING_FETCH_MODE_STATE_OF_CHARGE
endchoice

# Display
config ZMK_DISPLAY
    default y

config ZMK_DISPLAY_BLANK_ON_IDLE
    default n

# LVGL draw buffer size as % of the screen
config LV_Z_VDB_SIZE
    default 100

# Screen pixel density used by LVGL for scaling
config LV_DPI_DEF
    default 161

# 1-bit monochrome Sharp memory LCD
config LV_Z_BITS_PER_PIXEL
    default 1

choice LV_COLOR_DEPTH
    default LV_COLOR_DEPTH_1
endchoice

choice ZMK_DISPLAY_WORK_QUEUE
    default ZMK_DISPLAY_WORK_QUEUE_DEDICATED
endchoice

choice ZMK_DISPLAY_STATUS_SCREEN
    default ZMK_DISPLAY_STATUS_SCREEN_CUSTOM
endchoice

config LV_Z_MEM_POOL_SIZE
    default 4096 if ZMK_DISPLAY_STATUS_SCREEN_CUSTOM

config ZMK_DISPLAY_STATUS_SCREEN_CUSTOM
    imply KB54_WIDGET_STATUS

config KB54_WIDGET_STATUS
    bool "Custom KB54 status widget"
    select LV_USE_IMG
    select LV_USE_CANVAS
    select LV_FONT_MONTSERRAT_22
    select LV_FONT_MONTSERRAT_18
    select LV_FONT_MONTSERRAT_16
    select LV_FONT_MONTSERRAT_14
    select LV_FONT_MONTSERRAT_12
    select LV_FONT_UNSCII_8
    select LV_FONT_UNSCII_16

# Code output
config USE_DT_CODE_PARTITION
    default y

config BUILD_OUTPUT_UF2
    default y

if USB

config USB_NRFX
    default y

config USB_DEVICE_STACK
    default y

endif # USB

endif # BOARD_KB54_NRF52840_L || BOARD_KB54_NRF52840_R
```

## config/boards/arm/kb54_nrf52840/kb54_nrf52840_r_defconfig
```kconfig
CONFIG_SOC_SERIES_NRF52X=y
CONFIG_SOC_NRF52840_QIAA=y
CONFIG_BOARD_KB54_NRF52840_R=y

# Keyboard IDs
CONFIG_ZMK_KEYBOARD_NAME="KB54 Right"
```

## config/boards/humancomputing/kb54/board.yml
```yaml
boards:
  - name: kb54_nrf52840_l
    vendor: humancomputing
    socs:
      - name: nrf52840
  - name: kb54_nrf52840_r
    vendor: humancomputing
    socs:
      - name: nrf52840
```
